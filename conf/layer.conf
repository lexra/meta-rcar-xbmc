## conf/layer.conf
```bitbake
# We might have a conf and classes directory, append to BBPATH
BBPATH .= ":${LAYERDIR}"

# We have a recipes directory, add to BBFILES
BBFILES += "${LAYERDIR}/recipes*/*/*.bb ${LAYERDIR}/recipes*/*/*.bbappend"

BBFILE_COLLECTIONS += "meta-rcar-xbmc"
BBFILE_PATTERN_meta-rcar-xbmc := "^${LAYERDIR}/"
BBFILE_PRIORITY_meta-rcar-xbmc = "8"

LAYERSERIES_COMPAT_meta-rcar-xbmc = "rocko dunfell"
```
